## provisioning/esp32/smart_desk/sdkconfig.defaults
```kconfig
# Store the current time/date timestamp in the app description structure
CONFIG_APP_COMPILE_TIME_DATE=y

# Enable Bluetooth and show the submenu with Bluetooth configuration choices.
CONFIG_BT_ENABLED=y
CONFIG_BT_NIMBLE_ENABLED=y

# Detect flash size when flashing bootloader
CONFIG_ESPTOOLPY_FLASHSIZE_DETECT=y

# Set flash size to 4MB
CONFIG_ESPTOOLPY_FLASHSIZE_4MB=y

# Configure the partition scheme to hold a factory app, and two OTA definitions
CONFIG_PARTITION_TABLE_SINGLE_APP=y
# CONFIG_PARTITION_TABLE_TWO_OTA=

# Enable FreeRTOS tracing and formatting functions
CONFIG_FREERTOS_USE_TRACE_FACILITY=y
CONFIG_FREERTOS_USE_STATS_FORMATTING_FUNCTIONS=y

# Enable hardware accelerated multiple precision integer operations, AES, and SHA
CONFIG_MBEDTLS_HARDWARE_AES=y
CONFIG_MBEDTLS_HARDWARE_MPI=y
CONFIG_MBEDTLS_HARDWARE_SHA=y

# Disable watchdog for CPU1 Idle task. We'll re-enable it after generating the
# RSA key pair, which is a time-consuming task.
# This is a workaround for
# After that issue is fixed, we can avoid disabling it, and manually enabling it
# when we're done with time-consuming tasks.
CONFIG_ESP_TASK_WDT_CHECK_IDLE_TASK_CPU1=n

# Set the default log level
# Level = INFO
CONFIG_LOG_DEFAULT_LEVEL=3
CONFIG_LOG_DEFAULT_LEVEL_INFO=y

# Level = DEBUG
# CONFIG_LOG_DEFAULT_LEVEL=4
# CONFIG_LOG_DEFAULT_LEVEL_DEBUG=y
```
